## firmware/west.yml
```yaml
manifest:
  version: "0.13"

  self:
    path: firmware

  remotes:
    - name: ncs
      url-base: https://github.com/nrfconnect

  defaults:
    remote: ncs

  projects:
    - name: nrf
      repo-path: sdk-nrf
      path: nrf
      revision: v3.4.1
      import:
        name-allowlist:
          - zephyr
          - mcuboot
          - nrfxlib
          - mbedtls
          - oberon-psa-crypto
          - cmsis
          - cmsis_6
          - hal_nordic
          - zcbor
          - tf-psa-crypto
          - segger
```
